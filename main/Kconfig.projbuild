## main/Kconfig.projbuild
```kconfig
menu "Home Assistant Sync"

config HA_SYNC_ENABLE
    bool "Enable Home Assistant sync (WebSocket + REST)"
    default y
    help
        Enable integration with Home Assistant using WebSocket updates and REST
        polling. Disable this if you do not want the device to connect to HA.

config HA_BASE_URL
    string "Home Assistant base URL"
    default "http://homeassistant.local:8123"
    help
        Base URL of the Home Assistant server, e.g. http://ha.local:8123.

config HA_AUTH_TOKEN
    string "Home Assistant long-lived access token"
    default "YOUR_LONG_LIVED_ACCESS_TOKEN"
    help
        Long-lived access token for Home Assistant. Do not include the "Bearer "
        prefix; it is added automatically.

config HA_POLL_INTERVAL_MS
    int "Home Assistant poll interval (ms)"
    default 5000
    range 0 600000
    help
        How often to poll Home Assistant via REST for state refresh. Set to 0 to
        disable periodic polling (WebSocket updates will still be used).

config HA_ENTITY_ID_SWITCH_1
    string "Entity ID for switch_1"
    default "switch.example_sw_1"
    help
        Entity ID to sync for the sw 1.

config HA_ENTITY_ID_SWITCH_2
    string "Entity ID for switch_2"
    default "switch.example_sw_2"
    help
        Entity ID to sync for the sw 2.

config HA_ENTITY_ID_AC
    string "Entity ID for AC"
    default "climate.example_ac"
    help
        Entity ID to sync for the AC.

config HA_ENTITY_ID_WEATHER
    string "Entity ID for Weather"
    default "card.example_weather"
    help
        Entity ID to sync for the weather card.

config HA_ENTITY_ID_1
    string "Extra entity ID #1"
    default ""
    help
        Optional additional entity ID to sync. Leave empty to disable.

config HA_ENTITY_ID_2
    string "Extra entity ID #2"
    default ""
    help
        Optional additional entity ID to sync. Leave empty to disable.

config HA_ENTITY_ID_3
    string "Extra entity ID #3"
    default ""
    help
        Optional additional entity ID to sync. Leave empty to disable.

config HA_ENTITY_ID_4
    string "Extra entity ID #4"
    default ""
    help
        Optional additional entity ID to sync. Leave empty to disable.

config HA_ENTITY_ID_5
    string "Extra entity ID #5"
    default ""
    help
        Optional additional entity ID to sync. Leave empty to disable.

endmenu
```
